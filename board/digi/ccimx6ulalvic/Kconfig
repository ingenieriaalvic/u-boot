## board/digi/ccimx6ulalvic/Kconfig
```kconfig
if TARGET_CCIMX6ULALVIC

config MCA
	bool
	default y

config SYS_BOARD
	default "ccimx6ulalvic"

config SYS_VENDOR
	default "digi"

config SYS_SOC
	default "mx6"

config SYS_CONFIG_NAME
	default "ccimx6ulalvic"

endif
```

## board/digi/ccimx6ulalviccl/Kconfig
```kconfig
if TARGET_CCIMX6ULALVICCL

config MCA
	bool
	default y

config SYS_BOARD
	default "ccimx6ulalviccl"

config SYS_VENDOR
	default "digi"

config SYS_SOC
	default "mx6"

config SYS_CONFIG_NAME
	default "ccimx6ulalviccl"

endif
```
